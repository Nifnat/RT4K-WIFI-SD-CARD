## main/Kconfig.projbuild
```kconfig
menu "SD Card"

    config SD_DISABLE_SDMMC
        bool "Disable SDMMC (use SPI-only mode)"
        default y
        help
            When enabled, the SD card driver skips SDMMC host probing entirely
            and falls back directly to SPI mode on every mount attempt.

            Useful when SDMMC is unavailable or is causing instability on your
            hardware revision. Toggle for SDMMC operation, which tries SDMMC
            1-bit first and falls back to SPI automatically.

endmenu
```

## sdkconfig.defaults
```kconfig
# Target
CONFIG_IDF_TARGET="esp32"

# Flash
CONFIG_ESPTOOLPY_FLASHSIZE_4MB=y
CONFIG_ESPTOOLPY_FLASHFREQ_40M=y

# CPU — 80 MHz keeps peak draw well within SD-slot limits
CONFIG_ESP_DEFAULT_CPU_FREQ_MHZ_80=y
CONFIG_ESP_DEFAULT_CPU_FREQ_MHZ=80

# Partition table
CONFIG_PARTITION_TABLE_CUSTOM=y
CONFIG_PARTITION_TABLE_CUSTOM_FILENAME="partitions.csv"

# WiFi
CONFIG_ESP_WIFI_SOFTAP_SUPPORT=y

# WiFi power / buffer tuning — reduce peak current for SD-slot supply;
# fewer TX buffers frees heap for the TCP receive window during uploads.
CONFIG_ESP_PHY_MAX_WIFI_TX_POWER=8
CONFIG_ESP_PHY_REDUCE_TX_POWER=y
CONFIG_ESP_WIFI_STATIC_RX_BUFFER_NUM=8
CONFIG_ESP_WIFI_DYNAMIC_RX_BUFFER_NUM=16
CONFIG_ESP_WIFI_DYNAMIC_TX_BUFFER_NUM=16
CONFIG_ESP_WIFI_AMPDU_TX_ENABLED=y
CONFIG_ESP_WIFI_TX_BA_WIN=8
CONFIG_ESP_WIFI_AMPDU_RX_ENABLED=y
CONFIG_ESP_WIFI_RX_BA_WIN=8

CONFIG_LWIP_TCP_SND_BUF_DEFAULT=16384
CONFIG_LWIP_TCP_WND_DEFAULT=16384
CONFIG_LWIP_TCP_RECVMBOX_SIZE=32
CONFIG_LWIP_UDP_RECVMBOX_SIZE=32
CONFIG_LWIP_TCPIP_RECVMBOX_SIZE=32
CONFIG_LWIP_TCP_SACK_OUT=y
CONFIG_LWIP_TCP_OOSEQ_MAX_PBUFS=8

# FreeRTOS
CONFIG_FREERTOS_HZ=1000
CONFIG_FREERTOS_USE_TICKLESS_IDLE=y
CONFIG_FREERTOS_IDLE_TIME_BEFORE_SLEEP=10

# Power management
CONFIG_PM_ENABLE=y
#CONFIG_PM_SLP_IRAM_OPT=n
#CONFIG_PM_RTOS_IDLE_OPT=n
#CONFIG_PM_SLP_DISABLE_GPIO=y

# Disable Bluetooth to save RAM
CONFIG_BT_ENABLED=n

# Compiler optimization for perf
CONFIG_COMPILER_OPTIMIZATION_PERF=y

# Log level - Info for production, Debug for development
CONFIG_LOG_DEFAULT_LEVEL_INFO=y
#CONFIG_LOG_DEFAULT_LEVEL_DEBUG=y
#CONFIG_MDNS_ENABLE_DEBUG_PRINTS=y
#CONFIG_MDNS_DEBUG_USE_ESP_LOG=y
#CONFIG_MDNS_DEBUG_BUFFER_SIZE=1024

# SPIFFS
CONFIG_SPIFFS_MAX_PARTITIONS=1

# HTTP Server
CONFIG_HTTPD_MAX_REQ_HDR_LEN=1024
CONFIG_HTTPD_MAX_URI_LEN=512

# FATFS for SD card
CONFIG_FATFS_LONG_FILENAMES=y
CONFIG_FATFS_LFN_HEAP=y
CONFIG_FATFS_MAX_LFN=255
```
